## CMakeLists.txt
```
# SPDX-License-Identifier: Apache-2.0

cmake_minimum_required(VERSION 3.20.0)

find_package(Zephyr REQUIRED HINTS $ENV{ZEPHYR_BASE})
project(nvs_storage)

target_sources(app PRIVATE src/main.c)
```

## sample.yaml
```
sample:
  name: nvs_storage
  description: Simple NVS Sample
```

## prj.conf
```kconfig
CONFIG_NVS=y
CONFIG_FLASH=y
# Add CONFIG_LOG if you want to see log from NVS
```

## src/main.c
```c
#include <zephyr.h>
#include <device.h>
#include <fs/nvs.h>
#include <storage/flash_map.h>
#include <string.h>

#define DEVICE_LABEL storage
#define KEY_ID 1
#define KEY_SIZE 12

static struct nvs_fs nvs = {
    .sector_size = DT_PROP(DT_CHOSEN(zephyr_flash), erase_block_size), //Got this from samples/nfc/writable_ndef_msg
    .sector_count = 2, //Decided based on how much the application needs
    .offset = FLASH_AREA_OFFSET(DEVICE_LABEL),
};

void main(void)
{
    ssize_t ret = 0;
    const struct device *nvs_dev;
    uint8_t key[KEY_SIZE];
    printk("-----------------\n");
    printk("NVS SIMPLE SAMPLE\n");
    printk("-----------------\n");

    nvs_dev = FLASH_AREA_DEVICE(DEVICE_LABEL);
    if(!device_is_ready(nvs_dev)){
        printk("Error: Device not ready\n");
        return; 
    }
    nvs_init(&nvs, nvs_dev->name);

    ret = nvs_read(&nvs, KEY_ID, key, sizeof(key));
    if(ret > 0){ // Key already in NVS
        printk("Key read from NVS: %s\n", key);
    }
    else{ // Key not in NVS
        strcpy(key,"password123");
        printk("Write key to NVS complete\n");
        nvs_write(&nvs, KEY_ID, key, sizeof(key));
    }
}
```
