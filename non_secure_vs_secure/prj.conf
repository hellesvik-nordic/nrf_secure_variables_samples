## CMakeLists.txt
```
# SPDX-License-Identifier: Apache-2.0

cmake_minimum_required(VERSION 3.20.0)

find_package(Zephyr REQUIRED HINTS $ENV{ZEPHYR_BASE})
project(secure_vs_non_secure)

target_sources(app PRIVATE src/main.c)
```

## prj.conf
```kconfig
#Enable PWM
CONFIG_PWM=y

#Configs for more debug info on fault
CONFIG_RESET_ON_FATAL_ERROR=n
CONFIG_THREAD_NAME=y
CONFIG_LOG=y
```

## app.overlay
```dts
&pwm0 {
		status = "okay";
		ch0-pin = < 0x2 >;
};

&pwm1 {
		status = "okay";
		ch0-pin = < 0x3 >;
};
```

## src/main.c
```c
/*
 * Copyright (c) 2012-2014 Wind River Systems, Inc.
 *
 * SPDX-License-Identifier: Apache-2.0
 */

#include <zephyr.h>
#include <sys/printk.h>
#include <device.h>
#include <drivers/pwm.h>

void set_pwm_pin_dim(const struct device *pwm, uint8_t pin_num){
	uint32_t max_period = 10000;
	uint32_t period = 500;
	const uint8_t flags = 0;

	pwm_pin_set_usec(pwm, pin_num, max_period, period,flags);
}



void main(void)
{
	printk("Start of Non-secure vs Secure example\n");
	printk("Hello World! %s\n", CONFIG_BOARD);
	
	const struct device *pwm0;
    pwm0 = device_get_binding(DT_LABEL(DT_NODELABEL(pwm0)));
	set_pwm_pin_dim(pwm0,2);	

	const struct device *pwm1;
    pwm1 = device_get_binding(DT_LABEL(DT_NODELABEL(pwm1)));
	set_pwm_pin_dim(pwm1,3);	

	printk("End of Non-secure vs Secure example\n");
}
```
